## config/boards/shields/kyria_nice_view_adapter/Kconfig.shield
```kconfig
# Copyright (c) 2026 Cathal O'Connor
# SPDX-License-Identifier: MIT

config SHIELD_KYRIA_NICE_VIEW_ADAPTER
    def_bool $(shields_list_contains,kyria_nice_view_adapter)
```

## config/west.yml
```yaml
# manifest:
#   remotes:
#     - name: zmkfirmware
#       url-base: https://github.com/zmkfirmware
#   projects:
#     - name: zmk
#       remote: zmkfirmware
#       revision: main
#       import: app/west.yml
#   self:
#     path: config
manifest:
  remotes:
    - name: zmkfirmware
      url-base: https://github.com/zmkfirmware
    - name: petejohanson
      url-base: https://github.com/petejohanson
    - name: roblim
      url-base: https://github.com/roblim
    - name: zzeneg # zmk-raw-hid, needed by KeyPeek
      url-base: https://github.com/zzeneg
    - name: srwi # zmk-keypeek-layer-notifier
      url-base: https://github.com/srwi
  projects:
    - name: zmk
      remote: zmkfirmware
      revision: main
      import: app/west.yml
    - name: zmk-raw-hid
      remote: zzeneg
      revision: main
    - name: zmk-keypeek-layer-notifier
      remote: srwi
      revision: master
  self:
    path: config
```
