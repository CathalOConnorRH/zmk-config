## config/modules/nice_view_adapter/Kconfig.defconfig
```kconfig
if SHIELD_NICE_VIEW_ADAPTER

config ZMK_DISPLAY
    default y

config SPI
    default y

config DISPLAY
    default y

endif # SHIELD_NICE_VIEW_ADAPTER 
```

## config/west.yml
```yaml
manifest:
  remotes:
    - name: zmkfirmware
      url-base: https://github.com/zmkfirmware
    # Additional modules containing boards/shields/custom code can be listed here as well
    # See https://docs.zephyrproject.org/3.2.0/develop/west/manifest.html#projects
  projects:
    - name: zmk
      remote: zmkfirmware
      revision: main
      import: app/west.yml
    - name: nice_view_adapter
      path: modules/nice_view_adapter
  self:
    path: config
    west-commands: scripts/west-commands.yml
    modules:
      - name: nice_view_adapter
        path: modules/nice_view_adapter
```
