#include <dt-bindings/zmk/matrix_transform.h>

&nice_view_spi {
    status = "okay";

    nice_view: nice_view@0 {
        compatible = "nice,nice_view";
        reg = <0>;
        spi-max-frequency = <4000000>;
        label = "DISPLAY";
        width = <250>;
        height = <122>;
    };
};

/ {
    chosen {
        zephyr,display = &nice_view;
    };
}; 